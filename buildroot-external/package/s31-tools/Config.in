## buildroot-external/package/s31-tools/Config.in
```kconfig
config BR2_PACKAGE_S31_TOOLS
	bool "ESP32-S31 runtime tools"
	default y
	help
	  Installs the device-tree overlay manager, radio module loader,
	  GPIO utility and persistent configuration archive helper.
```
